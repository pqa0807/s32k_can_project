VERSION "1.0"

NS_ :

BS_:

BU_: ECU

BO_ 513 TeslaModel3_Actuator: 8 ECU
	SG_ VCFRONT_pumpBatteryRPMActual : 3|10@0+ (10,0) [0|10230] "RPM" ECU
	SG_ VCFRONT_pumpPowertrainRPMActual : 13|10@0+ (10,0) [0|10230] "RPM" ECU
	SG_ VCFRONT_tempSuperheatActual : 34|10@0+ (0.1,-20) [-20|42.6] "C" ECU

BO_ 995 TeslaModel3_RightTurnSignal: 2 ECU
	SG_ VCRIGHT_turnSignalStatus : 4|2@0+ (1,0) [0|3] "" ECU
	VAL_ VCRIGHT_turnSignalStatus 0 "OFF" 1 "ON" 2 "FAULT" 3 "SNA";

BO_ 994 TeslaModel3_LeftTurnSignal: 7 ECU
	SG_ VCRIGHT_turnSignalStatus : 4|2@0+ (1,0) [0|3] "" ECU
	VAL_ VCRIGHT_turnSignalStatus 0 "OFF" 1 "ON" 2 "FAULT" 3 "SNA";

BO_ 524 TeslaModel3_HVAC: 8 ECU
	SG_ VCRIGHT_wattsDemandEvap : 0|11@0+ (5,0) [0|10235] "W" ECU
	SG_ VCRIGHT_tempEvaporator : 13|11@0+ (0.1,-40) [-40|87.5] "C" ECU
	SG_ VCRIGHT_hvacBlowerSpeedRPMReq : 32|10@0+ (5,0) [0|5115] "RPM" ECU

BO_ 577 TeslaModel3_Coolant: 8 ECU
	SG_ VCFRONT_coolantFlowBatActual : 0|9@0+ (0.1,0) [0|102.3] "L/min" ECU
	SG_ VCFRONT_coolantFlowPTActual : 22|9@0+ (0.1,0) [0|102.3] "L/min" ECU

BO_ 627 TeslaModel3_Wiper: 7 ECU
	SG_ UI_wiperMode : 6|2@0+ (1,0) [0|3] "" ECU
	VAL_ UI_wiperMode 0 "OFF" 1 "LOW" 2 "HIGH" 3 "AUTO";

BO_ 950 TeslaModel3_Odometer: 4 ECU
	SG_ UI_odometer : 0|32@0+ (0.001,0) [0|4294967.295] "km" ECU

BO_ 801 TeslaModel3_FrontSensor: 8 ECU
	SG_ VCFRONT_tempCoolantBatInlet : 0|10@0+ (0.125,-40) [-40|87.5] "C" ECU
	SG_ VCFRONT_tempCoolantPT : 10|11@0+ (0.125,-40) [-40|87.5] "C" ECU
	SG_ UI_outsideTemp : 40|8@0+ (0.5,-40) [-40|87.5] "C" ECU

BO_ 264 TeslaModel3_DIRTorque: 8 ECU
	SG_ DIR_rearAxleSpeed : 40|16@0+ (0.1,0) [-3276.8|3276.7] "RPM" ECU
	SG_ DIR_rearAxleTorqueActual : 27|13@0+ (2,0) [-4096|4094] "Nm" ECU

BO_ 599 TeslaModel3_VehicleSpeed: 8 ECU
	SG_ DI_vehicleSpeed : 12|12@0+ (0.08,-40) [-40|204.4] "km/h" ECU

BO_ 658 TeslaModel3_BMS_SOC: 8 ECU
	SG_ SOCUI292 : 10|10@0+ (0.1,0) [0|100] "%" ECU

BO_ 280 TeslaModel3_PedalGear: 8 ECU
	SG_ DI_accelPedalPos : 32|8@0+ (0.4,0) [0|102] "%" ECU
	SG_ DI_gear : 21|3@0+ (1,0) [0|7] "" ECU
	VAL_ DI_gear 0 "INVALID" 1 "P" 2 "R" 3 "N" 4 "D" 5 "SNA";

BO_ 297 TeslaModel3_SteeringAngle: 8 ECU
	SG_ SteeringAngle129 : 16|14@0+ (0.1,-819.2) [-819.2|819.1] "deg" ECU
	SG_ SteeringSpeed129 : 32|14@0+ (0.5,-4096) [-4096|4095.5] "deg/s" ECU

BO_ 306 TeslaModel3_HVBattAmpVolt: 8 ECU
	SG_ BattVoltage132 : 0|16@0+ (0.01,0) [0|655.35] "V" ECU
	SG_ SmoothBattCurrent132 : 16|16@0- (-0.1,0) [-3276.8|3276.7] "A" ECU

BO_ 472 TeslaModel3_RearTorque: 8 ECU
	SG_ RearTorque1D8 : 21|13@0- (0.222,0) [-4096|4094] "Nm" ECU
